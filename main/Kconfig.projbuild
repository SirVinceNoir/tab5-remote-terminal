## main/Kconfig.projbuild
```kconfig
menu "Tab5 Remote Terminal"

    config TAB5_SSH_HOST
        string "SSH test host (Phase 2 spike)"
        default "10.1.3.236"
        help
            Hardcoded SSH test target for the Phase 2 libssh2_esp spike.

    config TAB5_SSH_PORT
        int "SSH test port"
        default 22

    config TAB5_SSH_USERNAME
        string "SSH test username"
        default ""

    config TAB5_SSH_PASSWORD
        string "SSH test password"
        default ""
        help
            Set via menuconfig, not committed as a literal in source.

    config TAB5_SSH_COMMAND
        string "Command to run over the test SSH connection"
        default "echo hello from tab5 && uname -a"

endmenu
```
